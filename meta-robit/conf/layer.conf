## meta-robit/conf/layer.conf
```bitbake
# We have a conf and classes directory, add to BBPATH
BBPATH .= ":${LAYERDIR}"

# We have recipes-* directories, add to BBFILES
BBFILES += "${LAYERDIR}/recipes-*/*/*.bb \
            ${LAYERDIR}/recipes-*/*/*.bbappend"

BBFILE_COLLECTIONS += "robit"
BBFILE_PATTERN_robit = "^${LAYERDIR}/"
BBFILE_PRIORITY_robit = "5"
LAYERVERSION_robit = "3"
```
